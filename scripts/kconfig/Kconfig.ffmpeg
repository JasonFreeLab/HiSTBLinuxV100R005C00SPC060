## scripts/kconfig/Kconfig.ffmpeg
```kconfig
menu "FFmpeg Config"

config HI_FFMPEF_SUPPORT
    bool "FFmpeg Support"
    help
        when enabled, support FFmpeg

    default y

endmenu
```

## scripts/kconfig/Kconfig.pcre
```kconfig
menu "PCRE Config"

config HI_PCRE_SUPPORT
    bool "PCRE Support"
    help
        when enabled, support pcre

    default y

config HI_PCRE2_SUPPORT
    bool "PCRE2 Support"
    help
        when enabled, support pcre2

    default n

endmenu
```

## scripts/kconfig/Kconfig.wfb_ng
```kconfig
menu "WFB-NG Config"

config HI_WFB_NG_SUPPORT
    bool "WFB-NG Support"
    help
        when enabled, support WFB-NG

    default y

endmenu
```

## source/component/wifi/drv/usb_rtl8812cu/rtl8812cu_monitor/Kconfig
```kconfig
config RTL8812CU
	tristate "Realtek 8812C USB WiFi"
	depends on USB
	---help---
	  Help message of RTL8812CU
```

## source/component/wifi/drv/usb_rtl8812cu/rtl88x2CU_WiFi_linux_v5.14.0.3-2-gba458274c.20220418_COEX20211210-2727/Kconfig
```kconfig
config RTL8822BU
	tristate "Realtek 8822C USB WiFi"
	depends on USB
	---help---
	  Help message of RTL8822CU
```
